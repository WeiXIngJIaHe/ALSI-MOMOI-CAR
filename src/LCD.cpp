#include "LCD.h"
#include "driver/i2c.h"
#include "esp_log.h"
#include "rom/ets_sys.h"
#include "freertos/FreeRTOS.h"
#include "freertos/task.h"
#include <cstring>

/* ================================================================ */
/* LCD1602 — PCF8574 + HD44780 字符液晶                               */
/* ================================================================ */

static const char *TAG_LCD = "LCD1602";

LCD1602::LCD1602(uint8_t addr, uint8_t cols, uint8_t rows)
    : _addr(addr), _cols(cols), _rows(rows),
      _backlight(LCD_FLAG_DISPLAY_ON),
      _display_ctrl(LCD_FLAG_DISPLAY_ON),
      _entry_mode(LCD_FLAG_ENTRY_LEFT)
{}

void LCD1602::_delayUs(uint32_t us)
{
    if (us < 1000) {
        ets_delay_us(us);
    } else {
        vTaskDelay(pdMS_TO_TICKS(us / 1000));
    }
}

void LCD1602::_i2c_write(uint8_t val)
{
    uint8_t data = val | _backlight;
    i2c_master_write_to_device(I2C_NUM_0, _addr, &data, 1, pdMS_TO_TICKS(10));
}

void LCD1602::_pulse_enable(uint8_t data)
{
    _i2c_write(data | (1 << 2));
    _delayUs(1);
    _i2c_write(data & ~(1 << 2));
    _delayUs(50);
}

void LCD1602::_write4bit(uint8_t data)   { _pulse_enable(data); }

void LCD1602::_write8bit(uint8_t data, bool rs)
{
    uint8_t hi = (data & 0xF0);
    uint8_t lo = (data & 0x0F) << 4;
    if (rs) hi |= 1;
    _write4bit(hi);
    if (lo) _write4bit(lo | (rs ? 1 : 0));
}

void LCD1602::init()
{
    _delayUs(50000);
    _write4bit(0x30); _delayUs(4500);
    _write4bit(0x30); _delayUs(150);
    _write4bit(0x30); _delayUs(150);
    _write4bit(0x20);

    _write8bit(LCD_CMD_FUNCTION_SET | LCD_FLAG_2LINE, false); _delayUs(50);
    _write8bit(LCD_CMD_DISPLAY_CTRL | LCD_FLAG_DISPLAY_ON, false); _delayUs(50);
    clear();
    _write8bit(LCD_CMD_ENTRY_MODE | LCD_FLAG_ENTRY_LEFT, false); _delayUs(50);

    ESP_LOGI(TAG_LCD, "OK (0x%02X, %dx%d)", _addr, _cols, _rows);
}

void LCD1602::clear()         { _write8bit(LCD_CMD_CLEAR, false); _delayUs(2000); }
void LCD1602::home()          { _write8bit(LCD_CMD_HOME, false);  _delayUs(2000); }

void LCD1602::setCursor(uint8_t col, uint8_t row)
{
    static const uint8_t off[] = { 0x00, 0x40, 0x14, 0x54 };
    col = (col < _cols) ? col : _cols - 1;
    row = (row < _rows) ? row : _rows - 1;
    _write8bit(LCD_CMD_SET_DDRAM | (col + off[row]), false);
    _delayUs(50);
}

void LCD1602::write(const char *str)      { while (*str) _write8bit(*str++, true); }
void LCD1602::writeChar(char c)           { _write8bit(c, true); }

void LCD1602::backlight(bool on)          { _backlight = on ? (1 << 3) : 0; _i2c_write(0x00); }

void LCD1602::display(bool on)
{
    if (on) _display_ctrl |=  LCD_FLAG_DISPLAY_ON;
    else    _display_ctrl &= ~LCD_FLAG_DISPLAY_ON;
    _write8bit(LCD_CMD_DISPLAY_CTRL | _display_ctrl, false);
}

void LCD1602::cursor(bool on)
{
    if (on) _display_ctrl |=  LCD_FLAG_CURSOR_ON;
    else    _display_ctrl &= ~LCD_FLAG_CURSOR_ON;
    _write8bit(LCD_CMD_DISPLAY_CTRL | _display_ctrl, false);
}

void LCD1602::blink(bool on)
{
    if (on) _display_ctrl |=  LCD_FLAG_BLINK_ON;
    else    _display_ctrl &= ~LCD_FLAG_BLINK_ON;
    _write8bit(LCD_CMD_DISPLAY_CTRL | _display_ctrl, false);
}

/* ================================================================ */
/* SSD1306 — 0.96寸 OLED 128×64                                      */
/* ================================================================ */

static const char *TAG_OLED = "SSD1306";

/* 6×8 ASCII 字体 */
static const uint8_t _font6x8[][6] = {
    {0x00,0x00,0x00,0x00,0x00,0x00}, {0x00,0x00,0x5F,0x00,0x00,0x00},
    {0x00,0x07,0x00,0x07,0x00,0x00}, {0x14,0x7F,0x14,0x7F,0x14,0x00},
    {0x24,0x2A,0x7F,0x2A,0x12,0x00}, {0x23,0x13,0x08,0x64,0x62,0x00},
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    {0x08,0x04,0x08,0x10,0x08,0x00},
};

/* ================================================================ */

SSD1306::SSD1306(uint8_t addr) : _addr(addr)  { clear(); }

void SSD1306::_sendCmd(uint8_t cmd)
{
    uint8_t buf[2] = { 0x00, cmd };
    i2c_master_write_to_device(I2C_NUM_0, _addr, buf, 2, pdMS_TO_TICKS(10));
}

void SSD1306::_sendData(const uint8_t *data, size_t len)
{
    uint8_t buf[33];
    buf[0] = 0x40;
    while (len > 0) {
        size_t chunk = (len > 32) ? 32 : len;
        std::memcpy(buf + 1, data, chunk);
        i2c_master_write_to_device(I2C_NUM_0, _addr, buf, chunk + 1, pdMS_TO_TICKS(20));
        data += chunk; len -= chunk;
    }
}

void SSD1306::init()
{
    _sendCmd(OLED_CMD_DISPLAY_OFF);
    _sendCmd(OLED_CMD_MEMORY_MODE); _sendCmd(0x00);
    _sendCmd(OLED_CMD_START_LINE | 0x00);
    _sendCmd(0x40);
    _sendCmd(0xD3); _sendCmd(0x00);
    _sendCmd(0xA8); _sendCmd(OLED_HEIGHT - 1);
    _sendCmd(0xA1); _sendCmd(0xC8);
    _sendCmd(0xDA); _sendCmd(0x12);
    _sendCmd(0xD5); _sendCmd(0x80);
    _sendCmd(0xD9); _sendCmd(0xF1);
    _sendCmd(0xDB); _sendCmd(0x30);
    _sendCmd(0x8D); _sendCmd(0x14);
    _sendCmd(0xA4);
    setContrast(0x7F);
    _sendCmd(OLED_CMD_DISPLAY_ON);
    clear(); display();
    ESP_LOGI(TAG_OLED, "OK (0x%02X, %dx%d)", _addr, OLED_WIDTH, OLED_HEIGHT);
}

void SSD1306::clear()          { std::memset(_buf, 0, sizeof(_buf)); }

void SSD1306::display()
{
    _sendCmd(OLED_CMD_COL_ADDR); _sendCmd(0); _sendCmd(OLED_WIDTH - 1);
    _sendCmd(OLED_CMD_PAGE_ADDR); _sendCmd(0); _sendCmd(OLED_PAGES - 1);
    _sendData(_buf, sizeof(_buf));
}

void SSD1306::setPixel(uint8_t x, uint8_t y, bool on)
{
    if (x >= OLED_WIDTH || y >= OLED_HEIGHT) return;
    if (on) _buf[x + (y / 8) * OLED_WIDTH] |=  (1 << (y & 7));
    else    _buf[x + (y / 8) * OLED_WIDTH] &= ~(1 << (y & 7));
}

void SSD1306::drawLine(uint8_t x0, uint8_t y0, uint8_t x1, uint8_t y1)
{
    int dx = abs((int)x1 - (int)x0), dy = -abs((int)y1 - (int)y0);
    int sx = x0 < x1 ? 1 : -1, sy = y0 < y1 ? 1 : -1;
    int err = dx + dy, e2;
    while (1) {
        setPixel(x0, y0, true);
        if (x0 == x1 && y0 == y1) break;
        e2 = 2 * err;
        if (e2 >= dy) { err += dy; x0 += sx; }
        if (e2 <= dx) { err += dx; y0 += sy; }
    }
}

void SSD1306::drawRect(uint8_t x, uint8_t y, uint8_t w, uint8_t h, bool fill)
{
    if (fill) {
        for (uint8_t i = 0; i < h; i++)
            for (uint8_t j = 0; j < w; j++)
                setPixel(x + j, y + i, true);
    } else {
        drawLine(x, y, x + w - 1, y); drawLine(x, y, x, y + h - 1);
        drawLine(x + w - 1, y, x + w - 1, y + h - 1);
        drawLine(x, y + h - 1, x + w - 1, y + h - 1);
    }
}

void SSD1306::drawCircle(uint8_t cx, uint8_t cy, uint8_t r, bool fill)
{
    int16_t f = 1 - r, x = 0, y = r;
    if (fill) for (int16_t i = y; i >= 0; i--) drawLine(cx - i, cy, cx + i, cy);
    setPixel(cx, cy + r, true); setPixel(cx, cy - r, true);
    setPixel(cx + r, cy, true); setPixel(cx - r, cy, true);
    while (x < y) {
        if (f >= 0) { y--; f += (2 * y); }
        x++; f += (2 * x - 1);
        setPixel(cx + x, cy + y, true); setPixel(cx - x, cy + y, true);
        setPixel(cx + x, cy - y, true); setPixel(cx - x, cy - y, true);
        setPixel(cx + y, cy + x, true); setPixel(cx - y, cy + x, true);
        setPixel(cx + y, cy - x, true); setPixel(cx - y, cy - x, true);
    }
}

void SSD1306::drawChar(uint8_t x, uint8_t y, char c)
{
    if (c < 0x20 || c > 0x7E) c = ' ';
    uint8_t idx = c - 0x20;
    for (uint8_t col = 0; col < 6; col++)
        for (uint8_t row = 0; row < 8; row++)
            setPixel(x + col, y + row, _font6x8[idx][col] & (1 << row));
}

void SSD1306::drawString(uint8_t x, uint8_t y, const char *str)
{
    while (*str) { drawChar(x, y, *str); x += 6; if (x + 6 > OLED_WIDTH) { x = 0; y += 8; } str++; }
}

void SSD1306::drawStringCenter(uint8_t y, const char *str)
{
    uint8_t len = strlen(str), x = (OLED_WIDTH - len * 6) / 2;
    drawString(x > OLED_WIDTH ? 0 : x, y, str);
}

void SSD1306::drawBitmap(uint8_t x, uint8_t y, const uint8_t *bmp, uint8_t w, uint8_t h)
{
    for (uint8_t r = 0; r < h; r++)
        for (uint8_t c = 0; c < w; c++)
            setPixel(x + c, y + r, bmp[(r * w + c) / 8] & (1 << (c & 7)));
}

void SSD1306::setContrast(uint8_t val)  { _sendCmd(OLED_CMD_SET_CONTRAST); _sendCmd(val); }
void SSD1306::invert(bool en)           { _sendCmd(en ? OLED_CMD_INVERT_DISP : OLED_CMD_NORMAL_DISP); }
void SSD1306::sleep(bool en)            { _sendCmd(en ? OLED_CMD_DISPLAY_OFF : OLED_CMD_DISPLAY_ON); }
